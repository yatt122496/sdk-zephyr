## boards/arm/bbqovn_a_release/Kconfig.defconfig
```kconfig
# Copyright (c) 2023 Nordic Semiconductor ASA
# SPDX-License-Identifier: Apache-2.0

if BOARD_BBQOVN_A_RELEASE

config BOARD
	default "bbqovn_a_release"

config BT_CTLR
   default BT

endif
```

## boards/shields/ht1621/Kconfig.shield
```kconfig
# Copyright (c) 2022 Jimmy Ou <yanagiis@gmail.com>
# SPDX-License-Identifier: Apache-2.0

config SHIELD_HT1621_8X8
	def_bool $(shields_list_contains,ht1621_8x8)
```

## drivers/display/Kconfig.ht1621
```kconfig
# Copyright (c) 2022 Jimmy Ou <yanagiis@gmail.com>
# SPDX-License-Identifier: Apache-2.0

config HT1621
	bool "HT1621 LED display driver"
	default y
	depends on DT_HAS_MAXIM_HT1621_ENABLED
	select SPI
	help
	  Enable driver for the Maxim HT1621 SPI LED display driver.
	  It is supporting up to 64 individual LEDs per HT1621.
```

## subsys/bluetooth/services/Kconfig.bbqovn
```kconfig
# Bluetooth GATT Heart Rate service

# Copyright (c) 2018 Nordic Semiconductor ASA
# SPDX-License-Identifier: Apache-2.0

menuconfig BT_BBQOVN
	bool "GATT BBQOVN service"

if BT_BBQOVN

config BT_BBQOVN_DISCONNECTED_DELAY_EN
	bool "BBQOVN Disconnect delay allowed"

config BT_BBQOVN_DISCONNECTED_DELAY_TIME
	int "BBQOVN Disconnect delay time (s)"
	default 10
	help
	  BBQOVN probe disconnection delay time.

endif # BT_BBQOVN
```
